## Practica 1/hello_world/main/Kconfig.projbuild
```kconfig
menu "RP1_Project Configuration"

    orsource "$IDF_PATH/examples/common_components/env_caps/$IDF_TARGET/Kconfig.env_caps"

    config TASK1_DELAY
        int "Task1 Delay in ms"
        range 10 3600000
        default 1000
        help
            Define the delay for Task 1 in milliseconds.

    config TASK2_DELAY
        int "Task2 Delay in ms"
        range 10 3600000
        default 1000
        help
            Define the delay for Task 2 in milliseconds.
endmenu
```
